## anypi_mira_dev/system/Sky39AV130/V1.01/configs/anyka_ak3918av130_driver_all_defconfig
```kconfig
# driver defconfig (Mira overlay: SDK tree ships no libdrv_uio.a)

# wifi config: NO_WIFI, atbm6031, atbm6032, atbm6441, hi3861l
CONFIG_WIFI_LINK=""
CONFIG_SENSOR_LINK=""
# sensor config
CONFIG_DRV_AKFAT=y
CONFIG_DRV_MMC=y
CONFIG_DRV_USB=y
CONFIG_DRV_USB2ETH=y
CONFIG_DRV_USB4G=y
CONFIG_DRV_UDC=y
CONFIG_DRV_UHC=y
CONFIG_DRV_USBRAW=y
CONFIG_DRV_TSENSOR=y
CONFIG_DRV_SERIAL_CORE=y
CONFIG_DRV_SENSOR_NEW=y
CONFIG_DRV_CAMERA_NEW=y
CONFIG_DRV_QUICK_START=y
CONFIG_DRV_I2C=y
CONFIG_DRV_ETHERNET=y
CONFIG_DRV_UART=y
CONFIG_DRV_GPIO=y
CONFIG_DRV_PCM=y
CONFIG_DRV_UIO=n
CONFIG_DRV_ION=y
CONFIG_DRV_SARADC=y
CONFIG_DRV_PWM=y
CONFIG_DRV_RTC=y
CONFIG_DRV_GPIO_KEY=y
CONFIG_DRV_ADC_KEY=y
CONFIG_DRV_LED=y
CONFIG_DRV_MOUNT=y
CONFIG_DRV_MOTOR=y
CONFIG_DRV_CRYPTO=y
CONFIG_DRV_VENC=y
CONFIG_DRV_VENC_BRIDGE=y
CONFIG_DRV_AK_PM=y
CONFIG_DRV_RANDOM=y
CONFIG_DRV_WLAN_CORE=y
CONFIG_DRV_SPI=y
CONFIG_DRV_EFUSE=y
CONFIG_DRV_I2C_CORE=y
CONFIG_DRV_V4L2_CORE=y
CONFIG_DRV_NPU=y
CONFIG_DRV_CIS_CONTROL=y
CONFIG_DRV_MBCD=y
```
